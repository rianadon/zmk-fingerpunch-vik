/*
 * Copyright (c) 2022 The ZMK Contributors
 *
 * SPDX-License-Identifier: MIT
 */

&vik_spi {
    status = "okay";
    cs-gpios = VIK_SPI_CS_PREFIX_PROCESSED <&vik_conn 6 GPIO_ACTIVE_LOW>;

    trackball: trackball@VIK_SPI_REG_START {
        status = "okay";
        compatible = "pixart,pmw3610";
        reg = <VIK_SPI_REG_START>;
        spi-max-frequency = <2000000>;
        irq-gpios = <&vik_conn 5 (GPIO_ACTIVE_LOW | GPIO_PULL_UP)>;

        /*   optional features   */
        // snipe-layers = <1>;
        // scroll-layers = <2 3>;
        // automouse-layer = <4>;
    };
};

/ {
    trackball_listener {
      compatible = "zmk,input-listener";
      device = <&trackball>;
  };
};
